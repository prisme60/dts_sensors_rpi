/dts-v1/;
/plugin/;

/ {
	compatible = "brcm,bcm2708";

	fragment@0 {
		target = <&i2c_arm>;
		__overlay__ {
			#address-cells = <1>;
			#size-cells = <0>;
			status = "okay";

		    /* Barometric pressure sensor */
		    bmp280@76 {
				compatible = "bosch,bmp280";
				reg = <0x76>;
			};
		};
		__overrides__ {
		};
	};
};
