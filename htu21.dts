/dts-v1/;
/plugin/;

/ {
	compatible = "brcm,bcm2708";

	fragment@0 {
		target = <&i2c_arm>;
		__overlay__ {
			#address-cells = <1>;
			#size-cells = <0>;
			status = "okay";
	
			/* Humidity Sensor */
			htu21@40 {
			   compatible = "meas-spec,htu21";
			   reg = <0x40>;
			};
		};
		__overrides__ {
		};
	};
};
